// 왼쪽 보드 (6x6, 슬레이브)
#include "mysplit.dtsi"

// Col0~5 : 100, 011, 104, 106, 031, 029
&kscan0 {
    col-gpios
        = <&pro_micro 6  GPIO_ACTIVE_HIGH>
        , <&pro_micro 7  GPIO_ACTIVE_HIGH>
        , <&pro_micro 8  GPIO_ACTIVE_HIGH>
        , <&pro_micro 9  GPIO_ACTIVE_HIGH>
        , <&pro_micro 21 GPIO_ACTIVE_HIGH>
        , <&pro_micro 20 GPIO_ACTIVE_HIGH>
        ;
};
